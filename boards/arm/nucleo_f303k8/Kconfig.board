## boards/arm/nucleo_f303k8/Kconfig.board
```kconfig
# STM32F3DISCOVERY board configuration

# Copyright (c) 2017 I-SENSE group of ICCS
# SPDX-License-Identifier: Apache-2.0

config BOARD_NUCLEO_F303K8
	bool "Nucleo F303k8 Development Board"
	depends on SOC_STM32F303X8
```

## boards/arm/nucleo_f303k8/Kconfig.defconfig
```kconfig
# STM32F3DISCOVERY board configuration

# Copyright (c) 2017 I-SENSE group of ICCS
# SPDX-License-Identifier: Apache-2.0

if BOARD_NUCLEO_F303K8

config BOARD
	default "nucleo_f303k8"

if UART_CONSOLE

config UART_2
	default y

endif # UART_CONSOLE

if PWM

config PWM_STM32_2
	default y

endif

endif # BOARD_NUCLEO_F303K8
```

## soc/arm/st_stm32/Kconfig.defconfig
```kconfig
# SPDX-License-Identifier: Apache-2.0

source "$(SOC_DIR)/arm/st_stm32/*/Kconfig.defconfig.series"
```
